## conf/layer.conf
```bitbake
# We have a conf and classes directory, add to BBPATH
BBPATH .= ":${LAYERDIR}"

# We have recipes-* directories, add to BBFILES
BBFILES += "${LAYERDIR}/recipes-*/*/*.bb \
            ${LAYERDIR}/recipes-*/*/*.bbappend"

BBFILE_COLLECTIONS += "meta-swupdate-rbxos"
BBFILE_PATTERN_meta-swupdate-rbxos = "^${LAYERDIR}/"
BBFILE_PRIORITY_meta-swupdate-rbxos = "21"

LAYERDEPENDS_meta-swupdate-rbxos = "core"
LAYERSERIES_COMPAT_meta-swupdate-rbxos = "honister"
```
